#include <dt-bindings/zmk/matrix_transform.h>

/ {
    chosen {
        zmk,kscan = &mock_kscan;
    };

    mock_kscan: mock_kscan_0 {
        compatible = "zmk,kscan-mock";
        columns = <0>;
        rows = <0>;
        events = <0>;
    };
	// TODO: COPY THE ENTIRE DEFAULT TRANSFORM MATICES OF MY KEYBOARD INTO THIS PLACE
};
